## app/audioctl/Kconfig
```kconfig
config SYSTEM_AUDIOCTL
	tristate "KICKPI-K7 audio control"
	default n
	depends on KICKPI_K7_AUDIO
	---help---
		Control KICKPI-K7 routing, channel mapping, and PCM processing.

if SYSTEM_AUDIOCTL

config SYSTEM_AUDIOCTL_PROGNAME
	string "Program name"
	default "audioctl"

config SYSTEM_AUDIOCTL_PRIORITY
	int "audioctl task priority"
	default 100

config SYSTEM_AUDIOCTL_STACKSIZE
	int "audioctl stack size"
	default 2048

endif
```

## app/dmaprobe/Kconfig
```kconfig
#
# For a description of the syntax of this configuration file,
# see the file kconfig-language.txt in the NuttX tools repository.
#

config EXAMPLES_DMAPROBE
	tristate "KICKPI-K7 ARM PL330 DMA controller bring-up probe"
	default n
	depends on RK3576_DMA
	---help---
		Bring-up self-test for the ARM PL330 (DMA-330) controller on the
		KICKPI-K7 board (dma-controller@2ab90000).  Acquires a
		memory-to-memory channel through the generic NuttX DMA framework
		(DMA_GET_CHAN / DMA_CONFIG / DMA_START), copies a seeded 512-byte
		source buffer to a cleared destination, waits for the completion
		interrupt and verifies the copy byte-for-byte.  Run as "dmaprobe"
		from NSH and observe the result on the console / syslog.

if EXAMPLES_DMAPROBE

config EXAMPLES_DMAPROBE_PROGNAME
	string "Program name"
	default "dmaprobe"

config EXAMPLES_DMAPROBE_PRIORITY
	int "dmaprobe task priority"
	default 100

config EXAMPLES_DMAPROBE_STACKSIZE
	int "dmaprobe stack size"
	default 4096

endif
```

## app/llm/Kconfig
```kconfig
#
# For a description of the syntax of this configuration file,
# see the file kconfig-language.txt in the NuttX tools repository.
#

config EXAMPLES_LLM
	tristate "端侧 LLM 推理引擎 (CPU transformer + 可选 NPU matmul)"
	default n
	depends on LIBM && LIBC_FLOATINGPOINT && PTHREAD_MUTEX_TYPES
	---help---
		LLaMA 系（LLaMA / TinyLlama / Qwen2 / Qwen2.5）decoder-only
		transformer 的完整推理引擎，纯 CPU（NEON + pthread 多核）即可跑通，
		这是 L2 保底路线。matmul 可在运行时切到 RKNPU（见 EXAMPLES_LLM_NPU）。
		权重 int4 分块量化（q4_0 布局），激活 fp32，KV-cache 增量解码。

if EXAMPLES_LLM

config EXAMPLES_LLM_NPU
	bool "把 matmul 卸载到 RKNPU"
	default n
	depends on RK3576_DMA_ALLOC
	---help---
		编入 NPU 卸载路径：激活转 fp16 暂存到 DMA 堆，调用
		rk3576_rknn_matmul_run()（弱符号，缺失则运行时自动回落 CPU）。
		未使能时引擎仍然完整可用，只是永远走 CPU 内核。

config EXAMPLES_LLM_PROGNAME
	string "Program name"
	default "llm"

config EXAMPLES_LLM_PRIORITY
	int "llm task priority"
	default 100

config EXAMPLES_LLM_STACKSIZE
	int "llm stack size"
	default 16384

endif
```

## app/nbootctl/Kconfig
```kconfig
config SYSTEM_NBOOTCTL
	tristate "N-Boot runtime control utility"
	default n
	depends on BOARDCTL_RESET
	select CRYPTO
	---help---
		Inspect the KICKPI-K7 N-Boot handoff and request a one-shot
		console, Fastboot, NuttX A, or NuttX B boot across a system reset.

if SYSTEM_NBOOTCTL


config SYSTEM_NBOOTCTL_PROGNAME
	string "Program name"
	default "nbootctl"

config SYSTEM_NBOOTCTL_PRIORITY
	int "Task priority"
	default 100

config SYSTEM_NBOOTCTL_STACKSIZE
	int "Task stack size"
	default 4096

config SYSTEM_NBOOTCTL_HEAPSIZE
	int "Task heap size"
	depends on MM_TASK_HEAP
	default MM_TASK_HEAP_DEFAULT_SIZE

endif
```

## app/nyabula/Kconfig
```kconfig
#
# For a description of the syntax of this file, see kconfig-language.txt in the
# NuttX tools repository.
#

menuconfig CONTEST2026_062_NYABULA
	bool "Nyabula companion application"
	default n
	depends on GRAPHICS_LVGL
	select HAVE_CXX
	select LIBCXX
	select LIBCXXABI
	select LV_USE_FLOAT
	select LV_USE_VECTOR_GRAPHIC
	select LV_USE_THORVG
	select LV_USE_THORVG_INTERNAL
	---help---
		Enable the Nyabula companion application and its dual-eye UI. The Eye
		Engine uses LVGL vector draw tasks and the antialiased ThorVG software
		backend; it does not contain a private framebuffer rasterizer.

if CONTEST2026_062_NYABULA

config CONTEST2026_062_NYABULA_PRIORITY
	int "Nyabula task priority"
	default 100

config CONTEST2026_062_NYABULA_STACKSIZE
	int "Nyabula task stack size"
	default 8192

config CONTEST2026_062_NYABULA_GATEWAY
	bool "Nyabula HTTP/JSON control gateway"
	default y
	depends on NET && NET_TCP && NETUTILS_CJSON
	---help---
		Expose the Nyabula Core v1 control API and embedded debug console.
		The gateway only validates and enqueues commands; Eye Engine calls stay
		on the LVGL owner thread.

config CONTEST2026_062_NYABULA_GATEWAY_PORT
	int "Nyabula control gateway port"
	default 8080
	range 1 65535
	depends on CONTEST2026_062_NYABULA_GATEWAY

config CONTEST2026_062_NYABULA_GATEWAY_STACKSIZE
	int "Nyabula control gateway stack size"
	default 16384
	range 4096 65536
	depends on CONTEST2026_062_NYABULA_GATEWAY

config CONTEST2026_062_NYABULA_DYNAMIC_FONTS
	bool "Load the complete Nyabula fonts with FreeType"
	default y
	select LIB_FREETYPE
	select LV_USE_FREETYPE
	---help---
		Load complete TTF assets at runtime so scene payloads are not limited to
		a build-time glyph subset. The generated fonts remain as a boot-safe
		fallback when the resource filesystem is unavailable.

config CONTEST2026_062_NYABULA_FONT_ROOT
	string "Nyabula complete font directory"
	default "/data/nyabula/fonts"
	depends on CONTEST2026_062_NYABULA_DYNAMIC_FONTS

endif
```

## app/nyampctl/Kconfig
```kconfig
config EXAMPLES_NYAMPCTL
	tristate "Nyabula AMP control diagnostic"
	default n
	depends on RPMSG_CHAR
	---help---
		Build the nyampctl health diagnostic for the Linux AMP compute domain.

if EXAMPLES_NYAMPCTL

config EXAMPLES_NYAMPCTL_PROGNAME
	string "Program name"
	default "nyampctl"

config EXAMPLES_NYAMPCTL_PRIORITY
	int "Task priority"
	default 100

config EXAMPLES_NYAMPCTL_STACKSIZE
	int "Task stack size"
	default 4096

endif
```

## boards/rk3576/kickpi-k7/Kconfig
```kconfig
#
# KICKPI-K7 (RK3576) board (out-of-tree vendor board)
#
config ARCH_BOARD_KICKPI_K7
	bool
	default y

if ARCH_BOARD_KICKPI_K7

config KICKPI_K7_WIFI
	bool "On-board SeekWave SV6621 WiFi/BT combo"
	default n
	depends on RK3576_SKW && RK3576_I2C
	---help---
		Configure the KICKPI-K7 pin environment, 32.768 kHz sleep clock,
		power sequence and firmware images for the on-board SV6621.

config KICKPI_K7_WIFI_IRAM
	string "SV6621 IRAM firmware image"
	default "SWT6621S_IRAM_SDIO.bin"
	depends on KICKPI_K7_WIFI

config KICKPI_K7_WIFI_DRAM
	string "SV6621 DRAM firmware image"
	default "SWT6621S_DRAM_SDIO.bin"
	depends on KICKPI_K7_WIFI

config KICKPI_K7_WIFI_NV
	string "SV6621 NV configuration image"
	default "SWT6621S_NV_SDIO_ALONE.bin"
	depends on KICKPI_K7_WIFI

config KICKPI_K7_WIFI_CALIB
	string "SV6621 RF calibration image"
	default "SWT6621S_SEEKWAVE_R00001.bin"
	depends on KICKPI_K7_WIFI

config KICKPI_K7_AUDIO
	bool "On-board ES8388 audio (SAI1 + I2C3)"
	default n
	depends on RK3576_SAI && RK3576_I2C
	select AUDIO_ES8388
	select AUDIO_FORMAT_PCM
	---help---
		Register the on-board Everest ES8388 codec (I2C3 @ 0x10) driven by
		the SAI1 I2S controller as the PCM audio device /dev/audio/pcm0.
		Muxes the SAI1 MCLK/SCLK/LRCK/SDO0/SDI0 pins at boot.

config KICKPI_K7_STORAGE_AUTOMOUNT
	bool "Automatic removable and on-board storage mounting"
	default y
	depends on FS_FAT && FS_TMPFS && GPT_PARTITION
	depends on SCHED_WORKQUEUE && SCHED_LPWORK
	depends on RK3576_SDMMC || RK3576_EMMC
	---help---
		Discover supported FAT data volumes without formatting media.  Prefer
		a usable eMMC data volume for /data, fall back to SD, and handle SD
		card insertion and removal.  /tmp remains a safe tmpfs; persistent
		temporary storage is published as /tmp/persist when /data is mounted.

endif # ARCH_BOARD_KICKPI_K7
```
